void pencet(int &x, int button, int interval) {
  int y = button * 2;
  w[y] = millis() % 300000;

  if (digitalRead(tombol[button]) == 0 && w[y] - w[y + 1] > interval) {
    x++;
    k[button] = 0;
    w[y + 1] = w[y];
  } else k[button] = 1;

}
void pencet(int &x, int button, int z, int interval) {
  int y = button * 2;
  w[y] = millis() % 300000;

  if (digitalRead(tombol[button]) == 0 && w[y] - w[y + 1] > interval) {
    if (z)x++;
    else x--;
    k[button] = 0;
    w[y + 1] = w[y];
  } else k[button] = 1;

}
//----------------------------------------------------------------------------------------------------------------------------------------------------------------------------------------------------------------------------------------------------------------

void joyy(int &x, int interval) {

  w[8] = millis() % 300000;
  if (analogRead(A4) < 400 && w[8] - w[9] > interval) {
    x++;
    w[9] = w[8];
  }
  else if (analogRead(A4) > 700 && w[8] - w[9] > interval) {
    x--;
    w[9] = w[8];
  }


}

//----------------------------------------------------------------------------------------------------------------------------------------------------------------------------------------------------------------------------------------------------------------

void joyx(int &x, int interval) {

  w[10] = millis() % 300000;
  if (analogRead(A5) < 400 && w[10] - w[11] > interval) {
    x--;
    w[11] = w[10];
  }
  else if (analogRead(A5) > 700 && w[10] - w[11] > interval) {
    x++;
    w[11] = w[10];
  }


}
//--------------------------------------------------------------
void clrscr() {
  for (int i = 0; i < 32; i++) {
    for (int j = 0; j < 16; j++) {
      dot[j][i].merah = 0;
      dot[j][i].biru = 0;
      dot[j][i].hijau = 0;
    }
  }
}

//-----------------------------------------------------------------------------------------------------------------------------------------------------------------------------------------------------------------------------------------------------------------------------------------------------

void jeda(int &x, int a, int y, int interval) {
  w[y] = millis() % 300000;
  if (w[y] - w[y + 1] > interval) {
    if (a)x++;
    else x--;
    w[y + 1] = w[y];
  }
}
//------------------------------------------------------------------------------------------------------------------------------------------------------------------------------------------------

void jedaa(int &x, int &b , int a, int q, int y, int interval) {
  w[y] = millis() % 300000;
  if (w[y] - w[y + 1] > interval) {
    if (a)x++;
    else x--;
    if (q)b++;
    else b--;
    w[y + 1] = w[y];
  }
}
//----------------------------------------------------------------------------------------------------------------------------------------

void berhenti(int x) {
  for (int i = 0; i <=  x / 16; i++) {
    cetak();
    delayMicroseconds(1);
  }
}
void berhenti(int x, int &a) {
  for (int i = 0; i <=  x / 16; i++) {
    cetak();
    delayMicroseconds(1);
    // Serial.println(a);
    // pencet(a,0,100);
    if (i > x)break;
    pencet(a, 1, 1000);
  }
}

